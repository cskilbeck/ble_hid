//////////////////////////////////////////////////////////////////////

#include "rwip_config.h"             // SW configuration

#include "custs1.h"
#include "custs1_task.h"
#include "gpio.h"
#include "user_custs1_def.h"
#include "user_periph_setup.h"
#include "ble_notify_button_wakeup.h"
#include "wkupct_quadec.h"

//////////////////////////////////////////////////////////////////////

timer_hnd app_param_update_request_timer_used __SECTION_ZERO("retention_mem_area0");
uint8_t app_connection_idx __SECTION_ZERO("retention_mem_area0");
void user_app_adv_start(void);

void user_move_wkup_cb(void);
void user_stop_wkup_cb(void);
 
//////////////////////////////////////////////////////////////////////

void app_wakeup_press_cb(void)
{
    return;
/*
    periph_init();

    arch_ble_force_wakeup();	

    // If wakeup is generated by button SW3
    if(!GPIO_GetPinStatus(GPIO_SW3_PORT, GPIO_SW3_PIN))						
    {
        app_easy_wakeup_set(user_move_wkup_cb);
    }
    // If wakeup is generated by button SW2
    else if (!GPIO_GetPinStatus(GPIO_SW2_PORT, GPIO_SW2_PIN))
    {
        app_easy_wakeup_set(user_stop_wkup_cb);
    }

    wkupct_enable_irq(WAKEUP_PINS, WAKEUP_POLARITIES, WAKEUP_EVENTS_TO_TRIGGER,
                      WAKEUP_DEBOUNCE_MS);
    
    // Invoke the chosen callback when the BLE stack is operational
    app_easy_wakeup();
*/
}

void user_move_wkup_cb(void)
{
    const char up_cmd[] = {'M', 'o', 'v', 'e', '!'};
    const size_t up_cmd_len = sizeof(up_cmd)/sizeof(up_cmd[0]);
	
    // Prepare the message to be sent
    struct custs1_val_ntf_ind_req *req = KE_MSG_ALLOC_DYN(CUSTS1_VAL_NTF_REQ,
                                                          prf_get_task_from_id(TASK_ID_CUSTS1),
                                                          TASK_APP,
                                                          custs1_val_ntf_ind_req,
                                                          DEF_SVC1_CTRL_POINT_CHAR_LEN);
		
    req->handle = SVC1_IDX_CONTROL_POINT_VAL;
    req->length = up_cmd_len;
    req->notification = true;
    memcpy(req->value, &up_cmd, up_cmd_len);
	
    // Send the message
    ke_msg_send(req);
}

//////////////////////////////////////////////////////////////////////

void user_stop_wkup_cb(void)
{
    const char stop_cmd[] = {'S', 't', 'o', 'p', '!'};
    const size_t stop_cmd_len = sizeof(stop_cmd)/sizeof(stop_cmd[0]);
	
    // Prepare the message to be sent
    struct custs1_val_ntf_ind_req *req = KE_MSG_ALLOC_DYN(CUSTS1_VAL_NTF_REQ,
                                                          prf_get_task_from_id(TASK_ID_CUSTS1),
                                                          TASK_APP,
                                                          custs1_val_ntf_ind_req,
                                                          DEF_SVC1_CTRL_POINT_CHAR_LEN);
		
    req->handle = SVC1_IDX_CONTROL_POINT_VAL;
    req->length = stop_cmd_len;
    req->notification = true;
    memcpy(req->value, &stop_cmd, stop_cmd_len);

    // Send the message
    ke_msg_send(req);
}

//////////////////////////////////////////////////////////////////////

void user_catch_rest_hndl(ke_msg_id_t const msgid,
                          void const *param,
                          ke_task_id_t const dest_id,
                          ke_task_id_t const src_id)
{
	switch(msgid)
	{
        // Check if the request is a Write Indication
        case CUSTS1_VAL_WRITE_IND:
        {
            const char hidden_msg_req[] = {'M', 'a', 'r', 'c', 'o', '?'};
            const char hidden_msg_resp[] = {'P', 'o', 'l', 'o', '!'};
            
            struct custs1_val_write_ind const *msg_param = (struct custs1_val_write_ind const *)(param);

            switch (msg_param->handle)
            {
                // Check if the message was destined to our custom service and if it matches the expected request 
                case SVC1_IDX_CONTROL_POINT_VAL:
                    if(!memcmp(&hidden_msg_req[0], &msg_param->value[0], msg_param->length)) {
                        size_t hidden_msg_resp_len = sizeof(hidden_msg_resp)/sizeof(hidden_msg_resp[0]);

                        struct custs1_val_ntf_ind_req *req = KE_MSG_ALLOC_DYN(CUSTS1_VAL_NTF_REQ,
                                                                              prf_get_task_from_id(TASK_ID_CUSTS1),
                                                                              TASK_APP,
                                                                              custs1_val_ntf_ind_req,
                                                                              DEF_SVC1_CTRL_POINT_CHAR_LEN);
                        // Send response 
                        req->handle = SVC1_IDX_CONTROL_POINT_VAL;
                        req->length = hidden_msg_resp_len;
                        req->notification = true;
                        memcpy(req->value, &hidden_msg_resp[0], hidden_msg_resp_len);
                        ke_msg_send(req);
                    }
                    break;

                default:
                    break;
                }
			}
			break;
			
			default:
                break;
	}
}

//////////////////////////////////////////////////////////////////////

static void param_update_request_timer_cb()
{
    app_easy_gap_param_update_start(app_connection_idx);
    app_param_update_request_timer_used = EASY_TIMER_INVALID_TIMER;
}

//////////////////////////////////////////////////////////////////////

void user_on_connection(uint8_t connection_idx, struct gapc_connection_req_ind const *param)
{
    if(app_env[connection_idx].conidx != GAP_INVALID_CONIDX) {
        app_connection_idx = connection_idx;

        // Check if the parameters of the established connection are the preferred ones.
        // If not then schedule a connection parameter update request.
        if((param->con_interval < user_connection_param_conf.intv_min) ||
           (param->con_interval > user_connection_param_conf.intv_max) ||
           (param->con_latency != user_connection_param_conf.latency) ||
           (param->sup_to != user_connection_param_conf.time_out)) {
            // Connection params are not these that we expect
            app_param_update_request_timer_used =
                app_easy_timer(APP_PARAM_UPDATE_REQUEST_TO, param_update_request_timer_cb);
        }
    } else {
        // No connection has been established, restart advertising
        user_app_adv_start();
    }
    // Enable the wakeup controller on connection
//    wkupct_enable_irq(WAKEUP_PINS, WAKEUP_POLARITIES, WAKEUP_EVENTS_TO_TRIGGER,
//                      WAKEUP_DEBOUNCE_MS);

    // Sets this function as wake-up interrupt callback	
//    wkupct_register_callback(app_wakeup_press_cb);	

    default_app_on_connection(connection_idx, param);
}

//////////////////////////////////////////////////////////////////////

void user_app_adv_undirect_complete(uint8_t status)
{
    // If advertising was canceled then update advertising data and start advertising again
    if(status == GAP_ERR_CANCELED) {
        user_app_adv_start();
    }
}

//////////////////////////////////////////////////////////////////////

void user_app_adv_start(void)
{
    app_easy_gap_undirected_advertise_start();
}

//////////////////////////////////////////////////////////////////////

void user_on_disconnect( struct gapc_disconnect_ind const *param )
{
    // Cancel the parameter update request timer
    if(app_param_update_request_timer_used != EASY_TIMER_INVALID_TIMER) {
        app_easy_timer_cancel(app_param_update_request_timer_used);
        app_param_update_request_timer_used = EASY_TIMER_INVALID_TIMER;
    }
    // Restart Advertising
    user_app_adv_start();
}

